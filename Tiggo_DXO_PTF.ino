/*
*
*
 * Система ПТФ v22.1. 
 * Разработано: Александр Курут (a.kurut@mail.ru), при поддержке DeepSeek AI (Дима).
 * https://chat.deepseek.com/share/q4t6md3w9rrs4c6gq5o8  под моим аккаунтом от Google
 * 
 * ═══════════════════════════════════════════════════════════════
 *                    ФУНКЦИОНАЛ СИСТЕМЫ
 * ═══════════════════════════════════════════════════════════════
 * 
 * ОСНОВНЫЕ ВОЗМОЖНОСТИ:
 * ✓ Плавное включение/выключение ПТФ через ШИМ (1250 Гц)
 * ✓ Задержка включения ДХО после запуска двигателя
 * ✓ Два режима задержки выключения:
 *   • 10 секунд — стандартная (габариты не использовались)
 *   • 60-30 секунд — вежливая подсветка (габариты были включены)
 * ✓ Автоматическое изменение яркости:
 *   • 70% (180/255) — базовый режим ДХО
 *   • 100% (255/255) — при включении габаритов или кнопки ПТФ
 * ✓ Управление шторкой дальнего света с защитами:
 *   • Антидребезг (100 мс на подъём, 50 мс на опускание)
 *   • Блокировка при неполной яркости (<250 из 255)
 * ✓ Защита АКБ от глубокого разряда (отключение при <11.5В)
 * ✓ Режим глубокого сна (Power-down) для экономии энергии
 * ✓ Пробуждение по изменению сигнала двигателя (прерывание)
 * 
 * ГИБКАЯ КОНФИГУРАЦИЯ (все флаги в начале кода):
 * ✓ Включение/отключение вежливой подсветки
 * ✓ Включение/отключение проверки напряжения двигателя
 * ✓ Включение/отключение аварийной защиты
 * ✓ Включение/отключение управления шторкой
 * ✓ Включение/отключение проверки яркости для шторки
 * ✓ Включение/отключение режима сна
 * ✓ Включение/отключение отладочного вывода
 * 
 * УЛУЧШЕНИЯ ВЕРСИИ 22.1:
 * + Добавлен Watchdog Timer для сверхнизкого потребления во сне
 * + Автоматический перезапуск при зависании (Watchdog)
 * + Все конфигурационные параметры вынесены в начало кода
 * + Улучшенная обработка пробуждения из сна
 * + Защита от многократного сна/пробуждения
 * 
 * ═══════════════════════════════════════════════════════════════
 *                    АППАРАТНАЯ ЧАСТЬ
 * ═══════════════════════════════════════════════════════════════
 * 
 * МИКРОКОНТРОЛЛЕР:
 * - ATmega168P (Arduino Nano/Uno совместимый)
 * 
 * ПИТАНИЕ:
 * - Постоянный плюс от АКБ (12В)
 * - DC-DC преобразователь 12В→5В (рекомендуется с защитой от помех)
 * - Защита: TVS-диод на входе, конденсаторы по входу и выходу
 * 
 * ПОДКЛЮЧЕНИЕ:
 * - D10 (ШИМ): управление яркостью ПТФ через MOSFET/LED-драйвер
 * - D6: управление шторкой (сервопривод/соленоид через реле)
 * - D2: сигнал габаритных огней (вход, подтяжка к GND)
 * - D4: сигнал дальнего света (вход, подтяжка к GND)
 * - D7: кнопка/тумблер ПТФ (вход, подтяжка к GND)
 * - D8: сигнал генератора/работы двигателя (вход + прерывание!)
 * - A0: датчик напряжения через делитель R1=22кОм, R2=9.98кОм
 * 
 * ВНИМАНИЕ:
 * - D8 используется как вход прерывания для пробуждения из сна
 * - Делитель напряжения ДОЛЖЕН быть откалиброван под конкретную плату
 * - При отключении сна (ENABLE_SLEEP_MODE = false) потребление ~5-15 мА
 *   что разрядит АКБ 55 Ач приблизительно за 150-450 дней
 * 
 * ═══════════════════════════════════════════════════════════════
 *                 ДИАГРАММА СОСТОЯНИЙ АВТОМАТА
 * ═══════════════════════════════════════════════════════════════
 * 
 *                    ┌─────────────────────────┐
 *                    │      STATE_OFF          │
 *                    │  (всё выключено, сон)   │
 *                    └────────────┬────────────┘
 *                                 │ двигатель запущен
 *                                 ▼
 *                    ┌─────────────────────────┐
 *                    │ STATE_ENGINE_START_WAIT │
 *                    │  (ждём 10 сек, ШИМ=0)   │
 *                    └────────────┬────────────┘
 *                         10 сек  │      │ двигатель заглушен
 *                                 ▼      ▼
 *                    ┌───────────────────────--──┐
 *                    │   STATE_DXO_ACTIVE        │◄──────-----──┐
 *                    │ (ДХО/ПТФ, яркость 70-100%)│              │
 *                    └────────────┬──────────--──┘              │
 *                                 │ двигатель заглушен          │ повторный запуск
 *                                 ▼                             │
 *                    ┌─────────────────────────┐                │
 *                    │ STATE_ENGINE_OFF_WAIT   │                │
 *                    │ (ждём N сек, свет горит)│                │
 *                    │ 10 сек / 60 сек         │                │
 *                    └────────────┬────────────┘                │
 *                          N сек  │       │ повторный запуск    │
 *                                 ▼       └──────────────────-──┘
 *                    ┌─────────────────────────┐
 *                    │    STATE_DIMMING        │
 *                    │  (плавное погасание)    │
 *                    └────────────┬────────────┘
 *                           ШИМ=0 │
 *                                 ▼
 *                    ┌─────────────────────────┐
 *                    │      STATE_OFF          │
 *                    │  (ждём 5 сек → сон)     │
 *                    └─────────────────────────┘
 */

// ============================================================
//                      ПОДКЛЮЧЕНИЕ БИБЛИОТЕК
// ============================================================

#include <GyverPWM.h>    // Расширенное управление ШИМ (частота, режимы)
#include <avr/sleep.h>   // Управление режимами сна микроконтроллера
#include <avr/power.h>   // Управление питанием периферии (экономия энергии)
#include <avr/wdt.h>     // Watchdog Timer (сторожевой таймер для сверхнадёжности)

// ============================================================
//           КОНФИГУРАЦИЯ СИСТЕМЫ (ВКЛЮЧИТЬ/ВЫКЛЮЧИТЬ)
// ============================================================
// Установите true/false для включения/отключения функций
// ВСЯ настройка системы делается ЗДЕСЬ — не нужно лезть в код!

// --- ОСНОВНЫЕ ФУНКЦИИ ---

#define ENABLE_COURTESY_LIGHT  true    // Вежливая подсветка после остановки двигателя
                                       // true = 60 секунд если были включены габариты
                                       // false = всегда 10 секунд, независимо от габаритов

#define ENABLE_ENGINE_VOLTAGE_CHECK  true  // Проверка напряжения для определения работы двигателя
                                            // true = анализировать напряжение (>13.6В = заведён)
                                            // false = только цифровой сигнал с генератора (D8)

#define ENABLE_EMERGENCY_STOP  true    // Аварийное отключение при низком напряжении (<11.5В)
                                       // true = выключать всё при разряде АКБ (рекомендуется!)
                                       // false = не отключать (опасно для АКБ — глубокий разряд!)

#define ENABLE_SHUTTER_CONTROL  true   // Управление шторкой дальнего света
                                       // true = шторка управляется автоматически
                                       // false = шторка всегда опущена (экономия пина D6)

#define ENABLE_SHUTTER_PWM_CHECK  true // Проверка яркости перед подъёмом шторки
                                       // true = шторка только при ШИМ >= 250 (защита от ослепления)
                                       // false = шторка при любой яркости (быстрее реакция)

#define ENABLE_SLEEP_MODE  true        // Режим глубокого сна для экономии АКБ
                                       // true = засыпать через 5 сек в STATE_OFF (потребление ~0.1 мкА)
                                       // false = не спать (потребление ~5-15 мА постоянно)

#define ENABLE_WATCHDOG  true          // Сторожевой таймер для автоматического перезапуска
                                       // true = перезагрузка при зависании (>8 сек без ответа)
                                       // false = без защиты от зависаний
                                       // ВНИМАНИЕ: если включён, нужно обязательно вызывать wdt_reset()

// #define DEBUG_MODE                   // Отладочный вывод в Serial Monitor
                                       //  и переведи  #define ENABLE_SLEEP_MODE  false
                                       //  раскомментируй для отладки
                                       // ВНИМАНИЕ: при DEBUG_MODE  сон не работает!
 
// ============================================================
//                 ОПРЕДЕЛЕНИЕ ПИНОВ МИКРОКОНТРОЛЛЕРА
// ============================================================

#define PIN_PWM           10   // D10: выход ШИМ для управления яркостью ПТФ
                                // Подключён к затвору MOSFET-транзистора или входу LED-драйвера
                                // Частота ШИМ: 1250 Гц (человеческий глаз не замечает мерцания)
                                // Используется таймер 1 (16 бит) для максимальной точности
                                
#define PIN_SHTORKA       6    // D6: выход управления шторкой дальнего света
                                // HIGH = шторка поднята (режим дальнего света)
                                // LOW = шторка опущена (режим ПТФ)
                                // Обычно управляет реле или сервоприводом
                                
#define PIN_GABARITS      2    // D2: вход сигнала габаритных огней
                                // HIGH = габариты включены
                                // Используется для автоматического увеличения яркости ПТФ
                                // и определения необходимости вежливой подсветки
                                
#define PIN_FARLIGHT      4    // D4: вход сигнала дальнего света
                                // HIGH = дальний свет включён
                                // Используется для управления шторкой ПТФ
                                
#define PIN_PTF_BUTTON    7    // D7: вход кнопки/тумблера ПТФ
                                // HIGH = кнопка нажата/тумблер включён
                                // Ручное управление яркостью ПТФ (100% при нажатии)
                                // Может использоваться для принудительного включения
                                
#define PIN_ENGINE_CHECK  8    // D8: вход сигнала работы двигателя/генератора
                                // Подключается к выходу "L" регулятора генератора
                                // или через оптрон к датчику давления масла
                                // HIGH = двигатель работает (генератор выдаёт напряжение)
                                // ВНИМАНИЕ: этот пин используется для пробуждения из сна!
                                // ДОЛЖЕН быть настроен как вход прерывания (PCINT0)
                                
#define PIN_VOLTAGE       A0   // Аналоговый пин A0: измерение напряжения бортсети
                                // Подключён к средней точке резистивного делителя
                                // Входное напряжение делится: Vпин = Vакб × R2/(R1+R2)
                                // Максимальное напряжение на пине: ~4.5В при 14.5В на АКБ

// ============================================================
//              ПАРАМЕТРЫ ДЕЛИТЕЛЯ НАПРЯЖЕНИЯ
// ============================================================
// ВНИМАНИЕ: эти значения критичны для точного измерения напряжения!
// При замене резисторов обязательно пересчитайте CORRECTION_FACTOR

const float DIV_R1 = 22000.0;          // Сопротивление верхнего плеча делителя в Омах
                                        // Резистор R1 подключён между +12В и аналоговым входом
                                        // Мощность резистора: не менее 0.25 Вт (при 14.5В: I=0.66мА, P=0.01Вт)
                                        // Рекомендуется использовать 1% точность
                                        
const float DIV_R2 = 9980.0;           // Сопротивление нижнего плеча делителя в Омах
                                        // Резистор R2 подключён между аналоговым входом и GND
                                        // Точное значение важно для корректного расчёта напряжения
                                        // Коэффициент деления: 22000/(22000+9980) ≈ 0.312
                                        // При 14.4В на входе: 14.4 × 0.312 ≈ 4.49В на пине
                                        
const float VREF_MV = 5113.0;          // Опорное напряжение АЦП в милливольтах
                                        // Измеряется экспериментально для конкретного экземпляра МК
                                        // Подаётся на вывод AREF или используется внутренний ИОН
                                        // Стандартное значение для ATmega168P: ~5000 мВ
                                        // Отклонение на 10 мВ даёт ошибку ~0.03В при измерении
                                        
const float CORRECTION_FACTOR = 3.25;   // Корректирующий множитель для реального напряжения
                                        // Учитывает погрешности резисторов, АЦП и наводки
                                        // ПОДБОР: измерьте напряжение мультиметром на клеммах АКБ
                                        // и сравните с показаниями в Serial Monitor
                                        // CORRECTION_FACTOR = Vмультиметр / Vмонитор
                                        // Пример: Vмультиметр=12.50, Vмонитор=12.35 → 12.50/12.35=1.012
                                        // Рекомендуется калибровать при 12.0-12.5В (двигатель заглушен)

// ============================================================
//           НАСТРАИВАЕМЫЕ ПАРАМЕТРЫ (менять здесь!)
// ============================================================
// Все временные интервалы в миллисекундах
// Для быстрой отладки можно временно уменьшить значения

// --- ЗАДЕРЖКИ (в миллисекундах) ---

const unsigned long DXO_DELAY_ON_MS = 10000;         // Задержка включения ДХО после запуска двигателя
                                                      // 10000 мс = 10 секунд
                                                      // Чтобы не слепить при запуске в тёмное время
                                                      // и не нагружать генератор сразу после старта
                                                      // Для отладки можно уменьшить до 2000 (2 сек)

const unsigned long DXO_DELAY_OFF_MS = 10000;        // Задержка выключения ПТФ после остановки двигателя
                                                      // Стандартная задержка (без габаритов)
                                                      // 10000 мс = 10 секунд

const unsigned long COURTESY_LIGHT_DELAY_MS = 30000; // Задержка выключения при вежливой подсветке
                                                      // Используется если были включены габариты
                                                      // 30000 мс = 30 секунд или сделать 1 минута
                                                      // Можно изменить: 120000 = 2 минуты, 30000 = 30 сек

const unsigned long SLEEP_TIMEOUT_MS = 60000;        // Таймаут до ухода в сон после STATE_OFF
                                                      // 60000 мс = 60 секунд (1 минута)
                                                      // Достаточно для коротких остановок
                                                      // Если двигатель не нужен >1 мин — можно спать

// --- ЯРКОСТЬ (значения ШИМ 0-255) ---

const uint8_t PWM_70_PERCENT = 180;     // Яркость в режиме ДХО (70%)
                                        // Рассчитано: 255 × 0.7 ≈ 178.5, округлено до 180
                                        // Безопасно для большинства светодиодов без радиатора
                                        // Если светодиоды греются — уменьшите до 150 (59%)

const uint8_t PWM_100_PERCENT = 255;    // Яркость в режиме ПТФ (100%)
                                        // Максимальная яркость
                                        // Требует эффективного теплоотвода!
                                        // При перегреве уменьшите до 230-240

const uint8_t PWM_OFF = 0;              // Полное выключение света
                                        // Пин принудительно прижимается к GND
                                        // для гарантированного отсутствия свечения

// --- ПЛАВНОСТЬ ИЗМЕНЕНИЯ ЯРКОСТИ ---

const uint8_t RAMP_STEP = 15;                  // Шаг изменения ШИМ за одну итерацию
                                                // Чем больше шаг — тем быстрее изменение, но менее плавно
                                                // 15 единиц = ~5.9% яркости за шаг
                                                // Полный цикл 0→255: 17 шагов × 5мс = 85 мс
                                                // Альтернативы:
                                                //   RAMP_STEP = 5  → 51 шаг × 5мс = 255 мс (очень плавно)
                                                //   RAMP_STEP = 30 → 8-9 шагов × 5мс = 40-45 мс (быстро)

const unsigned long RAMP_INTERVAL_MS = 5;       // Интервал между шагами в миллисекундах
                                                // Определяет скорость плавного изменения
                                                // 5мс даёт комфортное глазу плавное изменение
                                                // Меньше 5мс — избыточно для человеческого глаза
                                                // Больше 10мс — заметны ступеньки яркости

// --- АНТИДРЕБЕЗГ СИГНАЛОВ ---

const unsigned long ENGINE_DEBOUNCE_MS = 200;   // Время стабилизации сигнала двигателя (мс)
                                                // Сигнал должен оставаться неизменным 200 мс
                                                // чтобы считаться достоверным
                                                // Защищает от:
                                                // - дребезга контактов реле регулятора
                                                // - кратковременных провалов напряжения
                                                // - электромагнитных помех от системы зажигания

// --- АНТИДРЕБЕЗГ ШТОРКИ ---

const unsigned long SHUTTER_DELAY_MS = 100;     // Задержка перед ПОДЪЁМОМ шторки (мс)
                                                // Предотвращает дёргание при кратковременных сигналах
                                                // 100 мс — оптимально для защиты от моргания дальним
                                                
const unsigned long SHUTTER_HOLD_MS = 50;       // Задержка перед ОПУСКАНИЕМ шторки (мс)
                                                // Меньше чем подъём — безопасность важнее
                                                // Быстрое опускание при пропадании условий
                                                
const uint8_t SHUTTER_PWM_THRESHOLD = 250;      // Порог яркости для подъёма шторки (из 255)
                                                // 250/255 ≈ 98% — практически полная яркость
                                                // Компромисс между скоростью и защитой:
                                                // - 255: идеально, но может не достигаться из-за пульсаций
                                                // - 250: запас 5 единиц на флуктуации ШИМ
                                                // - 230: запас 25 единиц — быстрее, но менее безопасно

// --- ПОРОГИ НАПРЯЖЕНИЯ (Вольты) ---

const float VOLTAGE_EMERGENCY = 11.5;    // Порог аварийного отключения
                                          // Напряжение полностью разряженного АКБ под нагрузкой
                                          // 11.5В = ~20% заряда свинцово-кислотного АКБ
                                          // Дальнейший разряд приведёт к сульфатации пластин

const float VOLTAGE_ENGINE_ON = 13.6;    // Порог уверенного ЗАПУСКА двигателя
                                          // При напряжении ВЫШЕ этого значения считается
                                          // что двигатель точно запущен и генератор работает
                                          // 13.6В = типичное напряжение заряда на холостых оборотах

const float VOLTAGE_ENGINE_OFF = 12.8;   // Порог уверенной ОСТАНОВКИ двигателя
                                          // При напряжении НИЖЕ этого значения считается
                                          // что двигатель заглушен (нет зарядки от генератора)
                                          // 12.8В = полностью заряженный АКБ без нагрузки
                                          // Гистерезис: 13.6 - 12.8 = 0.8В (исключает дребезг)

// --- ПАУЗА ГЛАВНОГО ЦИКЛА ---

const unsigned long LOOP_DELAY_MS = 30;  // Пауза между итерациями loop() в миллисекундах
                                          // 30 мс = ~33 итерации в секунду
                                          // Достаточно для быстрой реакции на все события
                                          // Снижает нагрузку на процессор (нет смысла опрашивать
                                          // датчики каждый микросекунду)

// ============================================================
//           СОСТОЯНИЯ КОНЕЧНОГО АВТОМАТА
// ============================================================
// Каждое состояние — уникальная фаза работы системы
// Переходы между состояниями строго определены логикой loop()

enum SystemState : uint8_t {
  STATE_OFF,               // 0: Всё выключено, ожидание запуска или уход в сон
                            // Переходы:
                            //   → STATE_ENGINE_START_WAIT (при запуске двигателя)
                            //   → СОН (через SLEEP_TIMEOUT_MS бездействия)
                            // В этом состоянии:
                            //   - ШИМ = 0
                            //   - Шторка опущена
                            //   - Все флаги сброшены
                            
  STATE_ENGINE_START_WAIT, // 1: Двигатель запущен, идёт отсчёт задержки ДХО
                            // Переходы:
                            //   → STATE_DXO_ACTIVE (по истечении DXO_DELAY_ON_MS)
                            //   → STATE_ENGINE_OFF_WAIT (при остановке двигателя)
                            // В этом состоянии:
                            //   - ШИМ = 0 (ДХО ещё не светят)
                            //   - Отсчитывается задержка включения
                            
  STATE_DXO_ACTIVE,        // 2: Двигатель работает, ДХО/ПТФ активны
                            // Переходы:
                            //   → STATE_ENGINE_OFF_WAIT (при остановке двигателя)
                            // В этом состоянии:
                            //   - ШИМ = 70% (ДХО) или 100% (ПТФ/габариты)
                            //   - Шторка управляется по условиям
                            //   - Отслеживается включение габаритов
                            
  STATE_ENGINE_OFF_WAIT,   // 3: Двигатель заглушен, ожидание погасания
                            // Переходы:
                            //   → STATE_DIMMING (по истечении задержки)
                            //   → STATE_ENGINE_START_WAIT (при повторном запуске)
                            // В этом состоянии:
                            //   - ШИМ сохраняет последнее значение (свет горит)
                            //   - Отсчитывается задержка выключения
                            //   - Длительность зависит от gabaritsWereOn
                            
  STATE_DIMMING            // 4: Плавное погасание ШИМ до нуля
                            // Переходы:
                            //   → STATE_OFF (при достижении ШИМ = 0)
                            //   → STATE_ENGINE_START_WAIT (при повторном запуске)
                            // В этом состоянии:
                            //   - ШИМ плавно уменьшается до 0
                            //   - Шторка принудительно опущена
};

SystemState currentState = STATE_OFF;  // Текущее состояние системы при старте — всё выключено
                                        // Эта переменная — "мозг" конечного автомата
                                        // Все решения принимаются на основе её значения

// ============================================================
//                 ГЛОБАЛЬНЫЕ ПЕРЕМЕННЫЕ
// ============================================================

// --- Таймеры и счётчики ---

unsigned long stateTimer = 0;            // Универсальный таймер для задержек в состояниях
                                          // Хранит время (millis()) входа в текущее состояние
                                          // Используется для расчёта задержек:
                                          //   millis() - stateTimer >= нужная_задержка
                                          // Перезапускается при каждой смене состояния

unsigned long lastRampTime = 0;          // Время последнего шага плавного изменения ШИМ
                                          // Хранит значение millis() последнего изменения
                                          // Используется для контроля интервала RAMP_INTERVAL_MS
                                          // Не позволяет менять ШИМ чаще, чем раз в 5 мс

unsigned long shutterChangeTimer = 0;    // Таймер антидребезга переключения шторки
                                          // 0 = таймер неактивен (состояние стабильно)
                                          // >0 = идёт отсчёт задержки перед переключением

unsigned long sleepTimer = 0;            // Таймер до ухода в режим сна
                                          // Отсчитывает SLEEP_TIMEOUT_MS в состоянии STATE_OFF
                                          // По истечении — переход в Power-down режим

// --- Переменные ШИМ ---

uint8_t currentPWM = 0;                  // Текущее значение ШИМ (всегда отражает реальность)
                                          // Диапазон: 0-255
                                          // Это значение УЖЕ установлено на пине PIN_PWM
                                          // Обновляется ТОЛЬКО функцией updatePWM()
                                          // Никакая другая часть кода не должна менять эту переменную!

uint8_t targetPWM = 0;                   // Целевое значение ШИМ (куда нужно плавно прийти)
                                          // Диапазон: 0-255
                                          // К этому значению стремится currentPWM
                                          // Устанавливается логикой состояний

// --- Флаги состояния ---

bool engineRunning = false;              // Флаг работы двигателя (true = работает)
                                          // Это стабильное, проверенное состояние
                                          // Используется всей логикой для принятия решений
                                          // Меняется только после антидребезга и проверки напряжения

bool shutterState = false;               // Текущее физическое состояние шторки
                                          // true = поднята (HIGH), false = опущена (LOW)
                                          // Отслеживаем, чтобы не дёргать пин без необходимости

bool gabaritsWereOn = false;             // Флаг использования габаритов при работающем двигателе
                                          // true = габариты были включены → вежливая подсветка 60 сек
                                          // false = габаритов не было → стандартные 10 сек
                                          // Сбрасывается при новом запуске двигателя

bool sleepScheduled = false;             // Запланирован ли уход в режим сна
                                          // true = таймер до сна запущен (отсчитывает SLEEP_TIMEOUT_MS)
                                          // false = сон не запланирован

// --- Переменные антидребезга двигателя ---

unsigned long engineStableTimer = 0;     // Таймер стабильности сигнала двигателя
                                          // Хранит время начала текущего уровня сигнала
                                          // Сбрасывается при ЛЮБОМ изменении сигнала на PIN_ENGINE_CHECK
                                          // Если сигнал держится дольше ENGINE_DEBOUNCE_MS — он стабилен

bool lastEngineCheckSignal = false;      // Предыдущее "сырое" значение сигнала двигателя
                                          // Нужно для детектирования ФАКТА изменения сигнала
                                          // Сравнивается с текущим чтением в debounceEngineSignal()
                                          // Инициализируется при старте в setup()

bool stableEngineCheckSignal = false;    // Стабилизированное значение сигнала двигателя
                                          // Это значение гарантированно держится >200 мс
                                          // Именно оно используется в isEngineRunning()
                                          // для определения работы двигателя

// --- Переменные режима сна ---

volatile bool wokenByInterrupt = false;  // Флаг пробуждения по прерыванию
                                          // Ключевое слово volatile — переменная может измениться
                                          // в любой момент в обработчике прерывания ISR()
                                          // true = контроллер проснулся по сигналу на D8

// ============================================================
//               ОТЛАДОЧНЫЕ СТРОКИ (только DEBUG_MODE)
// ============================================================

#ifdef DEBUG_MODE
// Строки названий состояний хранятся во Flash-памяти через PROGMEM
// для экономии драгоценного SRAM (у ATmega168P всего 1024 байта SRAM!)
// Индексы соответствуют значениям SystemState (0=OFF, 1=START_WAIT, ...)

const char stateNames_0[] PROGMEM = "OFF";              // Название состояния STATE_OFF
const char stateNames_1[] PROGMEM = "START_WAIT";       // Название состояния STATE_ENGINE_START_WAIT
const char stateNames_2[] PROGMEM = "DXO_ACTIVE";       // Название состояния STATE_DXO_ACTIVE
const char stateNames_3[] PROGMEM = "OFF_WAIT";         // Название состояния STATE_ENGINE_OFF_WAIT
const char stateNames_4[] PROGMEM = "DIMMING";          // Название состояния STATE_DIMMING

// Массив указателей на строки состояний
// Используется для быстрого доступа к строке по индексу состояния
const char* const stateNames[] PROGMEM = {
  stateNames_0,  // Индекс 0 → "OFF"
  stateNames_1,  // Индекс 1 → "START_WAIT"
  stateNames_2,  // Индекс 2 → "DXO_ACTIVE"
  stateNames_3,  // Индекс 3 → "OFF_WAIT"
  stateNames_4   // Индекс 4 → "DIMMING"
};
#endif

// ============================================================
//           ОБРАБОТЧИК ПРЕРЫВАНИЯ ДЛЯ ПРОБУЖДЕНИЯ
// ============================================================

/**
 * Обработчик прерывания Pin Change Interrupt 0 (PCINT0).
 * 
 * СРАБАТЫВАЕТ: при ЛЮБОМ изменении сигнала на пинах порта B (D8-D13)
 * Мы настроили маску так, что реагирует только на D8 (PB0/PCINT0)
 * 
 * РАБОТАЕТ ДАЖЕ ВО СНЕ: это аппаратное прерывание,
 * которое пробуждает контроллер из Power-down режима
 * 
 * ЧТО ДЕЛАЕТ:
 * - Устанавливает флаг wokenByInterrupt = true
 * - Не выполняет НИКАКОЙ сложной логики (экономия времени)
 * - Основная логика обрабатывает пробуждение в loop()
 * 
 * ВНИМАНИЕ:
 * - Код в ISR должен быть МИНИМАЛЬНЫМ и БЫСТРЫМ
 * - Нельзя использовать delay(), Serial.print() и долгие операции
 * - Глобальные переменные, меняемые в ISR, должны быть volatile
 */
ISR(PCINT0_vect) {
  wokenByInterrupt = true;  // Устанавливаем флаг пробуждения
                             // Основная логика увидит его в loop()
                             // и выполнит необходимые действия после пробуждения
}

// ============================================================
//           ОБРАБОТЧИК СТОРОЖЕВОГО ТАЙМЕРА
// ============================================================

/**
 * Обработчик прерывания сторожевого таймера (Watchdog Timer).
 * 
 * НАЗНАЧЕНИЕ: защита от зависания программы
 * Если программа "зависла" и не сбрасывает таймер — 
 * watchdog перезагрузит контроллер
 * 
 * ПЕРИОД: ~8 секунд (зависит от настроек предделителя)
 * 
 * ЧТО ДЕЛАЕТ: просто подавляет сброс, позволяя использовать
 * watchdog как таймер для периодического пробуждения из сна
 */
ISR(WDT_vect) {
  // В этой версии не используем watchdog для пробуждения,
  // только для защиты от зависаний.
  // Если нужно периодическое пробуждение — можно добавить флаг здесь.
}

// ============================================================
//                  ФУНКЦИИ ЧТЕНИЯ ДАТЧИКОВ
// ============================================================

/**
 * Чтение напряжения бортсети с аналогового пина A0.
 * 
 * ПРИНЦИП РАБОТЫ:
 * 1. АЦП измеряет напряжение на пине (0-5В → 0-1023)
 * 2. Пересчитывается в реальное напряжение с учётом:
 *    - Опорного напряжения АЦП (VREF_MV = 5113 мВ)
 *    - Делителя напряжения и калибровки (CORRECTION_FACTOR = 3.25)
 * 
 * ВОЗВРАЩАЕТ:
 * - float: напряжение бортсети в Вольтах (например, 14.23)
 * 
 * ПОГРЕШНОСТЬ:
 * - ±0.05-0.1В при правильной калибровке
 * - Зависит от стабильности опорного напряжения
 * - Рекомендуется калибровать при 12.0-12.5В
 * 
 * ВРЕМЯ ВЫПОЛНЕНИЯ: ~100 мкс (микросекунд)
 */
float readVoltage() {
  // Читаем "сырое" значение АЦП (0-1023)
  // analogRead() занимает ~100 мкс при стандартной частоте АЦП
  int rawADC = analogRead(PIN_VOLTAGE);
  
  // Пересчитываем в напряжение на пине (0-5В)
  // Формула: Vпин = (rawADC × VREF_MV / 1024) / 1000
  // rawADC × VREF_MV — масштабируем в милливольты
  // / 1024.0 — преобразуем в долю от опорного (10 бит = 1024 градации)
  // / 1000.0 — переводим милливольты в вольты
  float voltageAtPin = (rawADC * VREF_MV / 1024.0) / 1000.0;
  
  // Применяем корректирующий коэффициент для получения реального напряжения
  // CORRECTION_FACTOR включает в себя и коэффициент делителя и калибровку
  float realVoltage = voltageAtPin * CORRECTION_FACTOR;
  
  // Возвращаем реальное напряжение бортсети в Вольтах
  return realVoltage;
}

// ============================================================
//                ФУНКЦИЯ АВАРИЙНОЙ ОСТАНОВКИ
// ============================================================

/**
 * Аварийное выключение всей системы при критически низком напряжении.
 * 
 * ВЫЗЫВАЕТСЯ: в каждом цикле loop() ПЕРВЫМ ДЕЛОМ (высший приоритет)
 * 
 * УСЛОВИЕ СРАБАТЫВАНИЯ:
 * - ENABLE_EMERGENCY_STOP == true (функция включена в конфигурации)
 * - voltage <= VOLTAGE_EMERGENCY (напряжение упало ниже 11.5В)
 * 
 * ЧТО ДЕЛАЕТ ПРИ СРАБАТЫВАНИИ:
 * 1. Принудительно выключает ШИМ (даже если идёт плавное изменение)
 * 2. Опускает шторку дальнего света
 * 3. Сбрасывает ВСЕ переменные состояния в начальные значения
 * 4. Переводит автомат в STATE_OFF
 * 5. Делает паузу 3 секунды для стабилизации напряжения
 * 
 * ЗАЩИТА ОТ ЛОЖНЫХ СРАБАТЫВАНИЙ:
 * - Пауза 3 сек предотвращает бесконечный цикл при пульсациях
 * - Однократное срабатывание на кратковременную просадку
 * - При затяжном разряде система останется выключенной
 */
void emergencyStop(float voltage) {
  // Проверяем, включена ли функция и нужно ли аварийно выключаться
  if (!ENABLE_EMERGENCY_STOP || voltage > VOLTAGE_EMERGENCY) return;
  
  // ========== БЛОК АВАРИЙНОГО ОТКЛЮЧЕНИЯ ==========
  
  // Принудительно устанавливаем ШИМ в 0
  PWM_set(PIN_PWM, PWM_OFF);
  
  // Дополнительно прижимаем пин ШИМ к LOW (GND)
  // Это гарантирует, что MOSFET-ключ ЗАКРЫТ и ток через светодиоды не течёт
  digitalWrite(PIN_PWM, LOW);
  
  // Опускаем шторку дальнего света
  digitalWrite(PIN_SHTORKA, LOW);
  
  // Сбрасываем текущее и целевое значения ШИМ в переменных
  currentPWM = PWM_OFF;
  targetPWM = PWM_OFF;
  
  // Сбрасываем флаг работы двигателя
  engineRunning = false;
  
  // Сбрасываем стабилизированный сигнал двигателя
  stableEngineCheckSignal = false;
  
  // Сбрасываем флаг вежливой подсветки
  gabaritsWereOn = false;
  
  // Сбрасываем состояние шторки
  shutterState = false;
  shutterChangeTimer = 0;
  
  // Отменяем запланированный сон
  sleepScheduled = false;
  
  // Переводим конечный автомат в начальное состояние
  currentState = STATE_OFF;
  
#ifdef DEBUG_MODE
  Serial.println(F("!!! EMERGENCY OFF !!!"));
#endif

  // Пауза 3 секунды для стабилизации напряжения
  delay(3000);
}

// ============================================================
//               ФУНКЦИЯ АНТИДРЕБЕЗГА СИГНАЛА
// ============================================================

/**
 * Антидребезг цифрового сигнала работы двигателя.
 * 
 * ПРОБЛЕМА:
 * - Сигнал с генератора может иметь кратковременные провалы
 * - Реле регулятора может "звенеть" при определённых нагрузках
 * - Электромагнитные помехи от системы зажигания искажают сигнал
 * - Без фильтрации это приводит к ложным срабатываниям и "морганию" света
 * 
 * РЕШЕНИЕ:
 * - Сигнал должен оставаться неизменным в течение ENGINE_DEBOUNCE_MS (200 мс)
 * - Только после этого он считается "стабильным" и используется в логике
 * - Это исключает одиночные помехи длительностью до 200 мс
 * 
 * ПАРАМЕТРЫ:
 * - rawSignal: "сырое" значение с пина PIN_ENGINE_CHECK (true/false)
 * 
 * ВОЗВРАЩАЕТ:
 * - bool: стабилизированное значение сигнала (после фильтрации)
 * 
 * ПОБОЧНЫЙ ЭФФЕКТ:
 * - Обновляет глобальную переменную stableEngineCheckSignal
 */
bool debounceEngineSignal(bool rawSignal) {
  // Получаем текущее время
  unsigned long now = millis();
  
  // Проверяем, изменился ли сигнал по сравнению с предыдущим чтением
  if (rawSignal != lastEngineCheckSignal) {
    // Сигнал изменился — сбрасываем таймер стабильности
    engineStableTimer = now;
    
    // Запоминаем новое значение как "последнее известное"
    lastEngineCheckSignal = rawSignal;
  }
  
  // Проверяем, прошло ли достаточно времени для признания сигнала стабильным
  if (now - engineStableTimer >= ENGINE_DEBOUNCE_MS) {
    // Сигнал держится дольше 200 мс — считаем его достоверным
    stableEngineCheckSignal = rawSignal;
  }
  
  // Возвращаем стабилизированное значение
  return stableEngineCheckSignal;
}

// ============================================================
//           ФУНКЦИЯ ОПРЕДЕЛЕНИЯ РАБОТЫ ДВИГАТЕЛЯ
// ============================================================

/**
 * Определение факта работы двигателя по сигналам датчиков.
 * 
 * РЕЖИМЫ РАБОТЫ (зависят от ENABLE_ENGINE_VOLTAGE_CHECK):
 * 
 * Режим 1 (ENABLE_ENGINE_VOLTAGE_CHECK = true) — ПОЛНАЯ ПРОВЕРКА:
 * - Использует и цифровой сигнал, и напряжение с гистерезисом
 * - Двигатель работает: стабильный HIGH на D8 И напряжение > 13.6В
 * - Двигатель заглушен: нет сигнала на D8 ИЛИ напряжение < 12.8В
 * - Гистерезис 0.8В исключает дребезг при граничных значениях
 * 
 * Режим 2 (ENABLE_ENGINE_VOLTAGE_CHECK = false) — ТОЛЬКО ЦИФРОВОЙ СИГНАЛ:
 * - Использует только стабильный сигнал с D8
 * - Двигатель работает: стабильный HIGH на D8
 * - Двигатель заглушен: стабильный LOW на D8
 * - Полезно при нестабильном напряжении или неоткалиброванном делителе
 * 
 * СТРАТЕГИЯ ПРИ НЕОДНОЗНАЧНОСТИ:
 * - Если условия противоречивы — сохраняется ПРЕДЫДУЩЕЕ состояние
 * - Это "серая зона" гистерезиса (для режима 1: 12.8В - 13.6В)
 * - Предотвращает метания при пограничных значениях
 * 
 * ПАРАМЕТРЫ:
 * - voltage: текущее напряжение бортсети в Вольтах
 * 
 * ВОЗВРАЩАЕТ:
 * - bool: true = двигатель работает, false = заглушен
 */
bool isEngineRunning(float voltage) {
  bool engineOff;
  bool engineOn;
  
  if (ENABLE_ENGINE_VOLTAGE_CHECK) {
    // Полная проверка: цифровой сигнал + напряжение
    engineOff = (!stableEngineCheckSignal) || (voltage < VOLTAGE_ENGINE_OFF);
    engineOn = (stableEngineCheckSignal) && (voltage > VOLTAGE_ENGINE_ON);
  } else {
    // Только цифровой сигнал (без проверки напряжения)
    engineOff = !stableEngineCheckSignal;
    engineOn = stableEngineCheckSignal;
  }
  
  // Принимаем решение на основе проверок
  if (engineOff) return false;  // Уверены, что заглушен
  if (engineOn) return true;    // Уверены, что работает
  
  // Неоднозначная ситуация — сохраняем предыдущее состояние
  return engineRunning;
}

// ============================================================
//            ФУНКЦИЯ ПЛАВНОГО УПРАВЛЕНИЯ ШИМ
// ============================================================

/**
 * ЕДИНСТВЕННАЯ функция управления яркостью через ШИМ.
 * 
 * ВАЖНО: Это единственная функция, которая меняет currentPWM!
 * Никакая другая часть кода не должна писать в currentPWM напрямую.
 * Это гарантирует целостность управления яркостью.
 * 
 * ПРИНЦИП:
 * - Плавно изменяет currentPWM в сторону targetPWM
 * - За один вызов может изменить ШИМ максимум на RAMP_STEP (15)
 * - Соблюдает интервал RAMP_INTERVAL_MS (5 мс) между изменениями
 * 
 * ОПТИМИЗАЦИЯ:
 * - Если currentPWM == targetPWM — мгновенный выход (самый частый случай)
 * - Не использует delay() — не блокирует выполнение программы
 * - Работает через проверку millis() (неблокирующий таймер)
 * 
 * БЕЗОПАСНОСТЬ:
 * - При достижении ШИМ=0 принудительно прижимает пин к GND
 * - Это предотвращает паразитное свечение светодиодов
 * - Даже при ШИМ=0 таймер может генерировать короткие импульсы
 */
void updatePWM() {
  // Если текущее значение уже равно целевому — ничего не делаем
  // Это САМЫЙ ЧАСТЫЙ случай (когда яркость не нужно менять)
  if (currentPWM == targetPWM) {
    // Дополнительная проверка: если ШИМ = 0, гарантируем низкий уровень на пине
    // Это защита от паразитного свечения светодиодов
    if (currentPWM == 0) {
      digitalWrite(PIN_PWM, LOW);
    }
    return;  // Выходим — цель достигнута, менять нечего
  }
  
  // Получаем текущее время для проверки интервала
  unsigned long now = millis();
  
  // Проверяем, прошло ли 5 мс с последнего изменения
  // Если нет — выходим, ждём следующего вызова loop()
  if (now - lastRampTime < RAMP_INTERVAL_MS) return;
  
  // Обновляем время последнего изменения
  // Теперь следующие 5 мс изменения не будет
  lastRampTime = now;
  
  // ===== ИЗМЕНЯЕМ ЯРКОСТЬ НА ОДИН ШАГ =====
  
  if (currentPWM < targetPWM) {
    // Случай 1: нужно УВЕЛИЧИТЬ яркость
    // Проверяем, не превысит ли шаг целевое значение
    if (currentPWM + RAMP_STEP > targetPWM) {
      // Если превысит — устанавливаем точно в цель
      currentPWM = targetPWM;
    } else {
      // Если не превысит — добавляем шаг
      currentPWM = currentPWM + RAMP_STEP;
    }
  } else {
    // Случай 2: нужно УМЕНЬШИТЬ яркость
    // Проверяем, не станет ли значение ниже целевого
    if (currentPWM - RAMP_STEP < targetPWM) {
      // Если станет ниже — устанавливаем точно в цель
      currentPWM = targetPWM;
    } else {
      // Если не станет — вычитаем шаг
      currentPWM = currentPWM - RAMP_STEP;
    }
  }
  
  // Применяем новое значение ШИМ к пину
  PWM_set(PIN_PWM, currentPWM);
  
  // Если достигли нуля — принудительно прижимаем пин к GND
  if (currentPWM == 0) {
    digitalWrite(PIN_PWM, LOW);
  }
}

// ============================================================
//             ФУНКЦИЯ УПРАВЛЕНИЯ ШТОРКОЙ
// ============================================================

/**
 * Управление шторкой дальнего света ПТФ с антидребезгом.
 * 
 * РЕЖИМЫ РАБОТЫ (зависят от конфигурации):
 * 
 * РЕЖИМ 1 (ENABLE_SHUTTER_CONTROL = true):
 * - Шторка управляется автоматически по условиям
 * - Дополнительные проверки если ENABLE_SHUTTER_PWM_CHECK = true
 * 
 * РЕЖИМ 2 (ENABLE_SHUTTER_CONTROL = false):
 * - Шторка всегда опущена (экономия пина D6)
 * - Пин принудительно удерживается в LOW
 * 
 * УСЛОВИЯ ПОДЪЁМА (все должны выполняться одновременно):
 * 1. Двигатель работает (engineRunning == true)
 * 2. Габариты ИЛИ кнопка ПТФ активны
 * 3. Дальний свет включён
 * 4. Яркость >= SHUTTER_PWM_THRESHOLD (если ENABLE_SHUTTER_PWM_CHECK = true)
 * 
 * АНТИДРЕБЕЗГ:
 * - Подъём: задержка SHUTTER_DELAY_MS (100 мс) — защита от моргания
 * - Опускание: задержка SHUTTER_HOLD_MS (50 мс) — быстрое выключение
 * - Если во время задержки условия изменились — таймер сбрасывается
 */
void updateShutter(bool ptfButton, bool gabarits, bool farLight) {
  // Если управление шторкой отключено в конфигурации — всегда опущена
  if (!ENABLE_SHUTTER_CONTROL) {
    if (shutterState) {
      // Шторка была поднята — опускаем
      digitalWrite(PIN_SHTORKA, LOW);
      shutterState = false;
      shutterChangeTimer = 0;
    }
    return;
  }
  
  // Проверяем условие яркости
  // Если проверка включена — яркость должна быть >= порога
  // Если проверка отключена — условие всегда истинно
  bool brightnessOk = ENABLE_SHUTTER_PWM_CHECK ? (currentPWM >= SHUTTER_PWM_THRESHOLD) : true;
  
  // Вычисляем, должны ли мы сейчас поднять шторку
  bool shouldBeUpNow = (engineRunning &&                    // Двигатель работает
                        (ptfButton || gabarits) &&          // ПТФ или габариты
                        farLight &&                         // Дальний свет
                        brightnessOk);                      // Яркость достаточна
  
  unsigned long now = millis();
  
  // Проверяем, совпадает ли желаемое состояние с текущим
  if (shouldBeUpNow != shutterState) {
    // Состояние должно измениться
    
    // Если таймер ещё не запущен — запускаем
    if (shutterChangeTimer == 0) {
      shutterChangeTimer = now;
    }
    
    // Вычисляем, сколько времени условия не совпадают
    unsigned long elapsed = now - shutterChangeTimer;
    
    // Выбираем задержку в зависимости от направления:
    // Подъём — дольше (защита от моргания)
    // Опускание — быстрее (безопасность)
    unsigned long requiredDelay = shouldBeUpNow ? SHUTTER_DELAY_MS : SHUTTER_HOLD_MS;
    
    // Если задержка истекла — выполняем переключение
    if (elapsed >= requiredDelay) {
      digitalWrite(PIN_SHTORKA, shouldBeUpNow ? HIGH : LOW);
      shutterState = shouldBeUpNow;
      shutterChangeTimer = 0;  // Сбрасываем таймер
      
#ifdef DEBUG_MODE
      Serial.print(F(" | Шторка: "));
      Serial.print(shutterState ? F("ON") : F("OFF"));
#endif
    }
    // Если задержка не истекла — ждём
    
  } else {
    // Состояние совпадает — сбрасываем таймер если был запущен
    // Это "прощает" кратковременные нарушения условий
    if (shutterChangeTimer != 0) {
      shutterChangeTimer = 0;
    }
  }
}

// ============================================================
//            ФУНКЦИИ УПРАВЛЕНИЯ РЕЖИМОМ СНА
// ============================================================

/**
 * Настройка сторожевого таймера (Watchdog Timer).
 * 
 * ВАРИАНТЫ ИСПОЛЬЗОВАНИЯ:
 * 
 * 1. Режим защиты от зависания (ENABLE_WATCHDOG = true):
 *    - Если программа зависла и не вызывает wdt_reset() >8 сек — перезагрузка
 *    - Надёжная защита от сбоев в дороге
 * 
 * 2. Режим периодического пробуждения (дополнительно):
 *    - Можно настроить на пробуждение каждые 8 сек для проверки АКБ
 *    - В текущей версии НЕ ИСПОЛЬЗУЕТСЯ для пробуждения
 *    - Пробуждение только по Pin Change Interrupt на D8
 * 
 * НАСТРОЙКА:
 * - Предделитель: 256 (самый большой интервал)
 * - Период срабатывания: ~8 секунд при тактовой частоте 16 МГц
 */
void setupWatchdog() {
  if (!ENABLE_WATCHDOG) return;
  
  // Сбрасываем watchdog перед настройкой
  wdt_reset();
  
  // Очищаем регистр управления watchdog
  MCUSR &= ~(1 << WDRF);
  
  // Настраиваем watchdog:
  // WDTCSR — Watchdog Timer Control and Status Register
  // WDCE — Watchdog Change Enable (разрешить изменение)
  // WDE — Watchdog Enable (включить watchdog)
  WDTCSR |= (1 << WDCE) | (1 << WDE);
  
  // Устанавливаем режим и предделитель:
  // WDIE — Watchdog Interrupt Enable (режим прерывания, не сброса!)
  // WDP3,WDP2,WDP1,WDP0 = 1,0,0,1 — предделитель 256 → ~8 сек
  // При зависании вызовет прерывание, а не мгновенный сброс
  WDTCSR = (1 << WDIE) | (1 << WDP3) | (1 << WDP0);
  
  // Теперь watchdog работает в режиме прерывания
  // Если программа зависнет — через 8 сек вызовется ISR(WDT_vect)
  // и произойдёт перезагрузка контроллера
}

/**
 * Настройка прерывания для пробуждения из сна.
 * 
 * ИСПОЛЬЗУЕТ: Pin Change Interrupt на порту B (PCINT0)
 * 
 * ПРИНЦИП:
 * - Пин D8 (PB0) на ATmega168P подключён к PCINT0
 * - Прерывание срабатывает при ЛЮБОМ изменении сигнала
 * - Это пробуждает контроллер из Power-down режима
 * 
 * КОНФИГУРАЦИЯ:
 * - PCIE0: разрешить прерывания от порта B
 * - PCINT0: маска — реагировать только на пин PB0 (D8)
 */
void setupWakeUpInterrupt() {
  // Разрешаем Pin Change Interrupt для порта B
  // PCICR — Pin Change Interrupt Control Register
  // PCIE0 — Pin Change Interrupt Enable для порта B
  PCICR |= (1 << PCIE0);
  
  // Выбираем пин PB0 (D8) для прерывания
  // PCMSK0 — Pin Change Mask Register 0 (для порта B)
  // PCINT0 — пин PB0 (Arduino D8)
  PCMSK0 |= (1 << PCINT0);
  
  // Сбрасываем флаг пробуждения
  wokenByInterrupt = false;
}

/**
 * Подготовка и вход в режим глубокого сна (Power-down).
 * 
 * Power-down — самый экономичный режим:
 * - Потребление: ~0.1 мкА (практически ничего!)
 * - Останавливается всё: ЦПУ, таймеры, АЦП, перифирия
 * - Продолжают работать: внешние прерывания, watchdog
 * 
 * ПОСЛЕ ПРОБУЖДЕНИЯ:
 * - Все регистры периферии СБРОШЕНЫ
 * - Необходима ПОЛНАЯ переинициализация: ШИМ, пины, Serial
 * - Микроконтроллер начнёт выполнение со СЛЕДУЮЩЕЙ после sleep_cpu() инструкции
 * 
 * ПРОЦЕСС ВХОДА В СОН:
 * 1. Настройка прерывания для пробуждения (пин D8)
 * 2. Отключение АЦП для экономии энергии
 * 3. Проверка: не произошло ли прерывание прямо сейчас
 * 4. Если нет — атомарный вход в сон (sleep_cpu)
 * 5. После пробуждения — восстановление всей периферии
 */
void enterSleep() {
#ifdef DEBUG_MODE
  Serial.println(F(">>> Уход в сон (Power-down)"));
  Serial.flush();  // Ждём завершения передачи всех данных
  delay(100);      // Даём время на физическую отправку по UART
#endif
  
  // Настраиваем прерывание для пробуждения (если ещё не настроено)
  setupWakeUpInterrupt();
  
  // Устанавливаем режим сна: Power-down (самый глубокий)
  // SMCR — Sleep Mode Control Register
  // SM1=1, SM0=0 → SLEEP_MODE_PWR_DOWN
  set_sleep_mode(SLEEP_MODE_PWR_DOWN);
  
  // Отключаем АЦП для дополнительной экономии энергии
  // Во сне он всё равно не работает
  ADCSRA &= ~(1 << ADEN);
  
  // Разрешаем сон (устанавливаем бит SE в SMCR)
  sleep_enable();
  
  // КРИТИЧЕСКАЯ СЕКЦИЯ: отключаем прерывания для атомарной проверки
  noInterrupts();
  
  // Проверяем, не произошло ли прерывание прямо сейчас
  if (!wokenByInterrupt) {
    // Прерываний не было — можно спать
    // sleep_cpu() атомарно разрешает прерывания и засыпает
    // Это гарантирует, что мы не пропустим прерывание между проверкой и сном
    interrupts();
    sleep_cpu();
    // ═══════════════════════════════════════════════════════
    // Код продолжит выполнение ЗДЕСЬ после пробуждения!
    // ═══════════════════════════════════════════════════════
  } else {
    // Прерывание произошло прямо перед сном — не засыпаем
    interrupts();
  }
  
  // После пробуждения (или отмены сна):
  sleep_disable();  // Запрещаем сон для нормальной работы
  
  // Восстанавливаем АЦП (был отключён для экономии)
  ADCSRA |= (1 << ADEN);
  
  // Переинициализируем ШИМ (регистры таймеров сбросились во сне)
  PWM_frequency(PIN_PWM, 1250, FAST_PWM);
  PWM_set(PIN_PWM, currentPWM);
  
  // Восстанавливаем состояние пинов (Mode и Output)
  pinMode(PIN_SHTORKA, OUTPUT);
  digitalWrite(PIN_SHTORKA, shutterState ? HIGH : LOW);
  
  // Переинициализируем watchdog если был включён
  if (ENABLE_WATCHDOG) {
    setupWatchdog();
  }
  
  // Сбрасываем все таймеры для корректной работы после пробуждения
  // millis() может показывать некорректное время после сна,
  // но для относительных задержек это не критично
  stateTimer = millis();
  lastRampTime = millis();
  engineStableTimer = millis();
  shutterChangeTimer = 0;
  sleepScheduled = false;
  
  // Инициализируем антидребезг заново
  lastEngineCheckSignal = digitalRead(PIN_ENGINE_CHECK);
  stableEngineCheckSignal = lastEngineCheckSignal;
  
#ifdef DEBUG_MODE
  Serial.begin(9600);  // Переинициализируем Serial после сна
  delay(100);
  Serial.println(F(">>> Пробуждение из сна"));
#endif
}

// ============================================================
//                 ФУНКЦИЯ ОТЛАДОЧНОГО ВЫВОДА
// ============================================================

#ifdef DEBUG_MODE
/**
 * Вывод отладочной информации в Serial Monitor.
 * 
 * ВЫВОДИТ В ОДНУ СТРОКУ:
 * - U=напряжение (В, 2 знака после запятой)
 * - G=габариты (Y/N)
 * - D=дальний (Y/N)
 * - P=кнопка ПТФ (Y/N)
 * - Gen=сигнал генератора (Y/N)
 * - Eng=двигатель работает (Y/N)
 * - G-Was=габариты были включены (Y/N)
 * - St=текущее состояние автомата
 * 
 * ВСЕ строки используют макрос F() для хранения во Flash-памяти.
 * Это критически важно для ATmega168P (всего 1024 байта SRAM).
 * 
 * ВНИМАНИЕ:
 * - Вывод занимает ~5-10 мс при скорости 9600 бод
 * - НЕ РАБОТАЕТ во время сна (Serial отключается)
 * - В финальной прошивке должен быть ОТКЛЮЧЁН
 */
void printDebug(float voltage, bool gabarits, bool farLight, bool ptfButton, bool engineRaw) {
  Serial.print(F("U="));
  Serial.print(voltage, 2);
  Serial.print(F("V G:"));
  Serial.print(gabarits ? 'Y' : 'N');
  Serial.print(F(" D:"));
  Serial.print(farLight ? 'Y' : 'N');
  Serial.print(F(" P:"));
  Serial.print(ptfButton ? 'Y' : 'N');
  Serial.print(F(" Gen:"));
  Serial.print(engineRaw ? 'Y' : 'N');
  Serial.print(F(" Eng:"));
  Serial.print(engineRunning ? 'Y' : 'N');
  Serial.print(F(" G-Was:"));
  Serial.print(gabaritsWereOn ? 'Y' : 'N');
  Serial.print(F(" St:"));
  Serial.print((const __FlashStringHelper*)pgm_read_ptr(&stateNames[currentState]));
}
#endif

// ============================================================
//                 ФУНКЦИЯ ИНИЦИАЛИЗАЦИИ SETUP
// ============================================================

/**
 * Инициализация системы при включении питания.
 * Выполняется ОДИН РАЗ при старте микроконтроллера.
 * 
 * ПОРЯДОК ИНИЦИАЛИЗАЦИИ:
 * 1. Настройка сторожевого таймера (если включён)
 * 2. Настройка режимов пинов (вход/выход)
 * 3. Настройка ШИМ (частота 1250 Гц, начальное значение 0)
 * 4. Установка начальных состояний выходов
 * 5. Инициализация Serial для отладки (если включена)
 * 6. Первичное чтение сигналов для антидребезга
 */
void setup() {
  // ===== СТОРОЖЕВОЙ ТАЙМЕР =====
  // Настраиваем до всего остального для защиты с самого начала
  setupWatchdog();
  
  // ===== НАСТРОЙКА РЕЖИМОВ ПИНОВ =====
  
  // Входы: настраиваем пины как INPUT (высокое входное сопротивление)
  pinMode(PIN_GABARITS, INPUT);      // Сигнал габаритных огней
  pinMode(PIN_FARLIGHT, INPUT);      // Сигнал дальнего света
  pinMode(PIN_PTF_BUTTON, INPUT);    // Кнопка/тумблер ПТФ
  pinMode(PIN_ENGINE_CHECK, INPUT);  // Сигнал работы двигателя (КРИТИЧЕН для пробуждения!)
  
  // Выходы: настраиваем пины как OUTPUT
  pinMode(PIN_SHTORKA, OUTPUT);      // Управление шторкой
  pinMode(PIN_PWM, OUTPUT);          // ШИМ управления яркостью
  
  // ===== НАСТРОЙКА ШИМ =====
  
  // Устанавливаем частоту ШИМ 1250 Гц в быстром режиме
  // Частота выше 1000 Гц незаметна для человеческого глаза
  // FAST_PWM — минимальная задержка между изменением регистра и выходом
  PWM_frequency(PIN_PWM, 1250, FAST_PWM);
  
  // Начальное значение ШИМ = 0 (свет выключен)
  PWM_set(PIN_PWM, PWM_OFF);
  
  // ===== НАЧАЛЬНЫЕ СОСТОЯНИЯ ВЫХОДОВ =====
  
  digitalWrite(PIN_SHTORKA, LOW);   // Шторка опущена
  digitalWrite(PIN_PWM, LOW);       // ШИМ принудительно в 0 (дублирование для надёжности)
  
  // Инициализация переменных состояния шторки
  shutterState = false;
  shutterChangeTimer = 0;
  
  // ===== ИНИЦИАЛИЗАЦИЯ ПЕРЕМЕННЫХ =====
  
  gabaritsWereOn = false;           // Габариты не были включены
  sleepScheduled = false;           // Сон не запланирован
  wokenByInterrupt = false;         // Пробуждения не было
  
  // ===== ИНИЦИАЛИЗАЦИЯ ОТЛАДКИ =====
  
#ifdef DEBUG_MODE
  Serial.begin(9600);
  Serial.println(F("=== ПТФ v22.1 (АКБ + сон + watchdog) ==="));
  Serial.println(F("Конфигурация:"));
  Serial.print(F("  Вежливая подсветка: "));
  Serial.println(ENABLE_COURTESY_LIGHT ? F("ВКЛ") : F("ВЫКЛ"));
  Serial.print(F("  Проверка напряжения: "));
  Serial.println(ENABLE_ENGINE_VOLTAGE_CHECK ? F("ВКЛ") : F("ВЫКЛ"));
  Serial.print(F("  Аварийная защита: "));
  Serial.println(ENABLE_EMERGENCY_STOP ? F("ВКЛ") : F("ВЫКЛ"));
  Serial.print(F("  Управление шторкой: "));
  Serial.println(ENABLE_SHUTTER_CONTROL ? F("ВКЛ") : F("ВЫКЛ"));
  Serial.print(F("  Проверка яркости шторки: "));
  Serial.println(ENABLE_SHUTTER_PWM_CHECK ? F("ВКЛ") : F("ВЫКЛ"));
  Serial.print(F("  Режим сна: "));
  Serial.println(ENABLE_SLEEP_MODE ? F("ВКЛ") : F("ВЫКЛ"));
  Serial.print(F("  Watchdog: "));
  Serial.println(ENABLE_WATCHDOG ? F("ВКЛ") : F("ВЫКЛ"));
#endif

  // ===== ИНИЦИАЛИЗАЦИЯ АНТИДРЕБЕЗГА =====
  
  // Читаем текущее состояние пина генератора
  lastEngineCheckSignal = digitalRead(PIN_ENGINE_CHECK);
  
  // Инициализируем стабилизированный сигнал тем же значением
  stableEngineCheckSignal = lastEngineCheckSignal;
  
  // Устанавливаем таймер стабильности на текущее время
  engineStableTimer = millis();
}

// ============================================================
//                  ГЛАВНЫЙ ЦИКЛ ПРОГРАММЫ
// ============================================================

/**
 * Главный цикл — выполняется бесконечно после setup().
 * 
 * Частота выполнения: ~33 раза в секунду (при LOOP_DELAY_MS = 30)
 * Каждая итерация занимает: ~30 мс (включая паузу)
 * 
 * СТРУКТУРА ЦИКЛА:
 * 1. Сброс сторожевого таймера (если включён)
 * 2. Сбор данных со всех датчиков
 * 3. Антидребезг критических сигналов
 * 4. Определение работы двигателя
 * 5. Аварийная проверка (высший приоритет)
 * 6. Обновление флага габаритов
 * 7. Определение переходов между состояниями
 * 8. Выполнение логики текущего состояния (конечный автомат)
 * 9. Управление шторкой
 * 10. Отладка (если включена)
 * 11. Пауза LOOP_DELAY_MS
 */
void loop() {
  // ============================================================
  // ШАГ 0: СБРОС СТОРОЖЕВОГО ТАЙМЕРА
  // ============================================================
  
  // Если watchdog включён — сообщаем ему что программа "жива"
  // Если не вызвать wdt_reset() в течение ~8 сек — произойдёт перезагрузка
  if (ENABLE_WATCHDOG) {
    wdt_reset();
  }
  
  // ============================================================
  // ШАГ 1: СБОР ДАННЫХ СО ВСЕХ ДАТЧИКОВ
  // ============================================================
  
  float voltage = readVoltage();                                     // Напряжение бортсети
  bool gabarits = (digitalRead(PIN_GABARITS) == HIGH);              // Габаритные огни
  bool farLight = (digitalRead(PIN_FARLIGHT) == HIGH);              // Дальний свет фар
  bool ptfButton = (digitalRead(PIN_PTF_BUTTON) == HIGH);           // Кнопка ПТФ
  bool engineCheckRaw = (digitalRead(PIN_ENGINE_CHECK) == HIGH);    // Сигнал генератора (сырой)
  
  // ============================================================
  // ШАГ 2: АНТИДРЕБЕЗГ СИГНАЛА ДВИГАТЕЛЯ
  // ============================================================
  
  debounceEngineSignal(engineCheckRaw);
  
  // ============================================================
  // ШАГ 3: ОПРЕДЕЛЕНИЕ РАБОТЫ ДВИГАТЕЛЯ
  // ============================================================
  
  engineRunning = isEngineRunning(voltage);
  
  // ============================================================
  // ШАГ 4: ОТЛАДОЧНЫЙ ВЫВОД (если DEBUG_MODE включён)
  // ============================================================
  
#ifdef DEBUG_MODE
  printDebug(voltage, gabarits, farLight, ptfButton, engineCheckRaw);
#endif
  
  // ============================================================
  // ШАГ 5: АВАРИЙНАЯ ПРОВЕРКА (ВЫСШИЙ ПРИОРИТЕТ)
  // ============================================================
  
  emergencyStop(voltage);
  
  // Если после emergencyStop система в STATE_OFF И напряжение всё ещё низкое —
  // пропускаем остальную логику (нет смысла работать при аварийном напряжении)
  if (currentState == STATE_OFF && voltage <= VOLTAGE_EMERGENCY) {
    delay(LOOP_DELAY_MS);
    return;
  }
  
  // ============================================================
  // ШАГ 6: ОБНОВЛЕНИЕ ФЛАГА ИСПОЛЬЗОВАНИЯ ГАБАРИТОВ
  // ============================================================
  
  // Запоминаем, что габариты были включены при работающем двигателе
  // Это нужно для определения режима вежливой подсветки
  if (engineRunning && (currentState == STATE_DXO_ACTIVE || currentState == STATE_ENGINE_START_WAIT)) {
    if (gabarits) {
      gabaritsWereOn = true;
    }
  }
  
    // ============================================================
  // ШАГ 7: ОПРЕДЕЛЕНИЕ ПЕРЕХОДОВ МЕЖДУ СОСТОЯНИЯМИ
  // ============================================================
  
  unsigned long now = millis();
  
  // ----- Переход: ДВИГАТЕЛЬ ЗАПУСТИЛСЯ -----
  // Условие: двигатель работает И мы не в активном режиме
  if (engineRunning && currentState != STATE_ENGINE_START_WAIT && currentState != STATE_DXO_ACTIVE) {
    
    // ВАЖНО: проверяем, КАК мы сюда попали
    if (currentState == STATE_ENGINE_OFF_WAIT || currentState == STATE_DIMMING) {
      // Случай 1: ВРЕМЕННОЕ ПРОПАДАНИЕ СИГНАЛА
      // Двигатель работал, сигнал кратковременно пропал, и теперь вернулся
      // НЕ сбрасываем яркость — сразу возвращаемся в активный режим!
#ifdef DEBUG_MODE
      Serial.println(F("\n>>> Сигнал восстановлен — возврат в DXO_ACTIVE"));
#endif
      currentState = STATE_DXO_ACTIVE;
      // Восстанавливаем яркость по текущим условиям (а не в 0!)
      targetPWM = (ptfButton || gabarits) ? PWM_100_PERCENT : PWM_70_PERCENT;
      lastRampTime = now;
      // Отменяем запланированный сон
      sleepScheduled = false;
      
    } else {
      // Случай 2: НОРМАЛЬНЫЙ ЗАПУСК ДВИГАТЕЛЯ
      // Система была в STATE_OFF — это реальный запуск
#ifdef DEBUG_MODE
      Serial.print(F("\n>>> Eng ON, wait "));
      Serial.print(DXO_DELAY_ON_MS / 1000);
      Serial.println(F("s"));
#endif
      currentState = STATE_ENGINE_START_WAIT;
      stateTimer = now;
      targetPWM = PWM_OFF;  // Свет выключен — ждём задержку
      lastRampTime = now;
      // Сбрасываем флаг вежливой подсветки при новом запуске
      gabaritsWereOn = false;
      // Отменяем запланированный сон
      sleepScheduled = false;
    }
  }
  
  // ----- Переход: ДВИГАТЕЛЬ ЗАГЛУШЕН -----
  // Условие: двигатель НЕ работает И состояние было активным
  if (!engineRunning && (currentState == STATE_ENGINE_START_WAIT || currentState == STATE_DXO_ACTIVE)) {
    
#ifdef DEBUG_MODE
    if (ENABLE_COURTESY_LIGHT && gabaritsWereOn) {
      Serial.print(F("\n>>> Eng OFF (ГАБАРИТЫ БЫЛИ ВКЛ), wait "));
      Serial.print(COURTESY_LIGHT_DELAY_MS / 1000);
      Serial.println(F("s"));
    } else {
      Serial.print(F("\n>>> Eng OFF, wait "));
      Serial.print(DXO_DELAY_OFF_MS / 1000);
      Serial.println(F("s"));
    }
#endif
    
    currentState = STATE_ENGINE_OFF_WAIT;
    stateTimer = now;
    // ВАЖНО: targetPWM НЕ меняем — свет продолжает гореть
    // с той же яркостью, что и до остановки двигателя!
    // Это реализует функцию "вежливого света"
  }
  
  // ============================================================
  // ШАГ 8: ЛОГИКА ТЕКУЩЕГО СОСТОЯНИЯ (КОНЕЧНЫЙ АВТОМАТ)
  // ============================================================
  
  switch (currentState) {
    
    // ============================================================
    // Состояние STATE_OFF: Всё выключено
    // Система ждёт запуска двигателя или уходит в сон
    // ============================================================
    case STATE_OFF:
      targetPWM = PWM_OFF;
      updatePWM();
      digitalWrite(PIN_SHTORKA, LOW);
      shutterState = false;
      
      // Планируем уход в сон (если режим сна включён)
      if (!sleepScheduled) {
        sleepScheduled = true;
        sleepTimer = now;
#ifdef DEBUG_MODE
        if (ENABLE_SLEEP_MODE) {
          Serial.print(F(" | Сон через "));
          Serial.print(SLEEP_TIMEOUT_MS / 1000);
          Serial.print(F(" сек..."));
        } else {
          Serial.print(F(" | Сон отключён"));
        }
#endif
      }
      
      // Проверяем, пора ли спать
      if (sleepScheduled && (now - sleepTimer >= SLEEP_TIMEOUT_MS)) {
        if (!engineRunning && !stableEngineCheckSignal) {
          if (ENABLE_SLEEP_MODE) {
            enterSleep();
            return;  // Пропускаем текущую итерацию
          } else {
            // Сон отключён — просто сбрасываем таймер
            sleepScheduled = false;
          }
        }
      }
      break;
      
    // ============================================================
    // Состояние STATE_ENGINE_START_WAIT: Ожидание включения ДХО
    // Двигатель работает, но свет ещё не горит
    // ============================================================
    case STATE_ENGINE_START_WAIT:
      updatePWM();
      
      if (now - stateTimer >= DXO_DELAY_ON_MS) {
#ifdef DEBUG_MODE
        Serial.println(F("\n>>> DXO ACTIVE"));
#endif
        currentState = STATE_DXO_ACTIVE;
        targetPWM = (ptfButton || gabarits) ? PWM_100_PERCENT : PWM_70_PERCENT;
        lastRampTime = now;
      }
      break;
      
    // ============================================================
    // Состояние STATE_DXO_ACTIVE: ДХО/ПТФ активны
    // Двигатель работает, свет горит
    // ============================================================
    case STATE_DXO_ACTIVE:
      {
        uint8_t desiredPWM = (ptfButton || gabarits) ? PWM_100_PERCENT : PWM_70_PERCENT;
        if (targetPWM != desiredPWM) {
          targetPWM = desiredPWM;
          lastRampTime = now;
        }
        updatePWM();
      }
      break;
      
    // ============================================================
    // Состояние STATE_ENGINE_OFF_WAIT: Ожидание погасания
    // Двигатель заглушен, свет пока горит
    // ============================================================
    case STATE_ENGINE_OFF_WAIT:
      updatePWM();
      
      {
        // Выбираем задержку: вежливая подсветка или стандартная
        unsigned long offDelay = (ENABLE_COURTESY_LIGHT && gabaritsWereOn) 
                                  ? COURTESY_LIGHT_DELAY_MS 
                                  : DXO_DELAY_OFF_MS;
        
        if (now - stateTimer >= offDelay) {
#ifdef DEBUG_MODE
          Serial.println(F("\n>>> DIMMING start"));
#endif
          currentState = STATE_DIMMING;
          targetPWM = PWM_OFF;
          lastRampTime = now;
        }
      }
      break;
      
    // ============================================================
    // Состояние STATE_DIMMING: Плавное погасание
    // ШИМ уменьшается от текущего значения до 0
    // ============================================================
    case STATE_DIMMING:
      updatePWM();
      
      if (currentPWM == PWM_OFF) {
#ifdef DEBUG_MODE
        Serial.println(F("\n>>> FULL OFF"));
#endif
        currentState = STATE_OFF;
        digitalWrite(PIN_SHTORKA, LOW);
        shutterState = false;
        
        // Сбрасываем флаг габаритов после завершения погасания
        gabaritsWereOn = false;
        
        // Запускаем таймер до сна
        sleepScheduled = true;
        sleepTimer = now;
      }
      break;
  }
  
  // ============================================================
  // ШАГ 9: УПРАВЛЕНИЕ ШТОРКОЙ (всегда, независимо от состояния)
  // ============================================================
  
  updateShutter(ptfButton, gabarits, farLight);
  
  // ============================================================
  // ШАГ 10: ЗАВЕРШЕНИЕ ИТЕРАЦИИ
  // ============================================================
  
#ifdef DEBUG_MODE
  Serial.println();
#endif

  delay(LOOP_DELAY_MS);
}
